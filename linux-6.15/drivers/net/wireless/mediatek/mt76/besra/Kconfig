## linux-6.15/drivers/net/wireless/mediatek/mt76/besra/Kconfig
```kconfig
# SPDX-License-Identifier: ISC
config BESRA
	tristate "MediaTek MT7902/MT7990 (PCIe) support"
	select MT76_CONNAC_LIB
	depends on MAC80211
	depends on PCI
	help
	  This adds support for MT7915-based wireless PCIe devices,
	  which support concurrent dual-band operation at both 5GHz
	  and 2.4GHz IEEE 802.11ax 4x4:4SS 1024-QAM, 160MHz channels,
	  OFDMA, spatial reuse and dual carrier modulation.

	  To compile this driver as a module, choose M here.
```

## linux-6.16/drivers/net/wireless/mediatek/mt76_new/mt7902_besra_to_mt7915/Kconfig
```kconfig
# SPDX-License-Identifier: ISC
config mt7902E
	tristate "MediaTek mt7902E (PCIe) support"
	select MT76_CONNAC_LIB
	select WANT_DEV_COREDUMP
	depends on MAC80211
	depends on PCI
	select RELAY
	help
	  This adds support for mt7902-based PCIe wireless devices,
	  which support concurrent dual-band operation at both 5GHz
	  and 2.4GHz IEEE 802.11ax 4x4:4SS 1024-QAM, 160MHz channels,
	  OFDMA, spatial reuse and dual carrier modulation.

	  To compile this driver as a module, choose M here.

config MT798X_WMAC
	bool "MT798x (SoC) WMAC support"
	depends on mt7902E
	depends on ARCH_MEDIATEK || COMPILE_TEST
	select REGMAP
	help
	  This adds support for the built-in WMAC on MT7981 and MT7986 SoC device
	  which has the same feature set as a mt7902, but enables 6E
	  support.
```

## linux-6.16/drivers/net/wireless/mediatek/mt76_new/mt7902_mt7921/Kconfig
```kconfig
# SPDX-License-Identifier: ISC
config mt7902_COMMON
	tristate
	select MT792x_LIB
	select WANT_DEV_COREDUMP

config mt7902E
	tristate "MediaTek mt7902E (PCIe) support"
	select mt7902_COMMON
	depends on MAC80211
	depends on PCI
	help
	  This adds support for mt7902E 802.11ax 2x2:2SS wireless devices.

	  To compile this driver as a module, choose M here.

config mt7902S
	tristate "MediaTek mt7902S (SDIO) support"
	select MT76_SDIO
	select mt7902_COMMON
	depends on MAC80211
	depends on MMC
	help
	  This adds support for mt7902S 802.11ax 2x2:2SS wireless devices.

	  To compile this driver as a module, choose M here.

config mt7902U
	tristate "MediaTek mt7902U (USB) support"
	select MT792x_USB
	select mt7902_COMMON
	depends on MAC80211
	depends on USB
	help
	  This adds support for mt7902U 802.11ax 2x2:2SS wireless devices.

	  To compile this driver as a module, choose M here.
```

## linux-6.16/drivers/net/wireless/mediatek/mt76_tnguy3333/mt7902_orig/Kconfig
```kconfig
# SPDX-License-Identifier: ISC
config MT7902E
	tristate "MediaTek MT7902E (PCIe) support"
	select MT792x_LIB
	select WANT_DEV_COREDUMP
	depends on MAC80211
	depends on PCI
	help
	  This adds support for MT7902E 802.11ax 2x2:2SS wireless devices.
```

## mt76/mt7902_1/Kconfig
```kconfig
# SPDX-License-Identifier: ISC
config MT7902
    tristate "MediaTek MT7902 (PCIe) support"
	select MT76_CONNAC_LIB
	select WANT_DEV_COREDUMP
	depends on MAC80211
	depends on PCI
	select RELAY
	help
	  This adds support for MT7915-based PCIe wireless devices,
	  which support concurrent dual-band operation at both 5GHz
	  and 2.4GHz IEEE 802.11ax 4x4:4SS 1024-QAM, 160MHz channels,
	  OFDMA, spatial reuse and dual carrier modulation.

	  To compile this driver as a module, choose M here.
```

## mt76/mt7902_2/Kconfig
```kconfig
# SPDX-License-Identifier: ISC
config MT7902_COMMON
	tristate
	select MT792x_LIB
	select WANT_DEV_COREDUMP

config MT7902E
	tristate "MediaTek MT7902E (PCIe) support"
	select MT7902_COMMON
	depends on MAC80211
	depends on PCI
	help
	  This adds support for MT7902-based wireless PCIe devices,
	  which support operation at 6GHz, 5GHz, and 2.4GHz IEEE 802.11be
	  2x2:2SS 4096-QAM, 160MHz channels.

	  To compile this driver as a module, choose M here.

config MT7902U
	tristate "MediaTek MT7902U (USB) support"
	select MT792x_USB
	select MT7902_COMMON
	depends on MAC80211
	depends on USB
	help
	  This adds support for MT7902-based wireless USB devices,
	  which support operation at 6GHz, 5GHz, and 2.4GHz IEEE 802.11be
	  2x2:2SS 4096-QAM, 160MHz channels.

	  To compile this driver as a module, choose M here.
```

## mt76_new/mt7902/Kconfig
```kconfig
# SPDX-License-Identifier: ISC
config MT7902_COMMON
	tristate
	select MT792x_LIB
	select WANT_DEV_COREDUMP

config MT7902E
	tristate "MediaTek MT7902E (PCIe) support"
	select MT7902_COMMON
	depends on MAC80211
	depends on PCI
	help
	  This adds support for MT7902E 802.11ax 2x2:2SS wireless devices.

	  To compile this driver as a module, choose M here.

config MT7902S
	tristate "MediaTek MT7902S (SDIO) support"
	select MT76_SDIO
	select MT7902_COMMON
	depends on MAC80211
	depends on MMC
	help
	  This adds support for MT7902S 802.11ax 2x2:2SS wireless devices.

	  To compile this driver as a module, choose M here.

config MT7902U
	tristate "MediaTek MT7902U (USB) support"
	select MT792x_USB
	select MT7902_COMMON
	depends on MAC80211
	depends on USB
	help
	  This adds support for MT7902U 802.11ax 2x2:2SS wireless devices.

	  To compile this driver as a module, choose M here.
```
